## mac80211/compat_wl18xx/drivers/net/wireless/ti/Kconfig
```kconfig
menuconfig WL_TI
	depends on !BACKPORT_KERNEL_2_6_30
	bool "TI Wireless LAN support"
	---help---
	  This section contains support for all the wireless drivers
	  for Texas Instruments WLAN chips, such as wl1251 and the wl12xx
	  family.

if WL_TI
source "drivers/net/wireless/ti/wl1251/Kconfig"
source "drivers/net/wireless/ti/wl12xx/Kconfig"
source "drivers/net/wireless/ti/wl18xx/Kconfig"

# keep last for automatic dependencies
source "drivers/net/wireless/ti/wlcore/Kconfig"

config UNIFIED_WILINK_PLATFORM_DATA
	bool "TI Wilink platform data (Unified)"
	default y if WILINK_PLATFORM_DATA || WL12XX_PLATFORM_DATA

endif # WL_TI
```
